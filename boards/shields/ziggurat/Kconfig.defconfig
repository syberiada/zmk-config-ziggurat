## boards/shields/ziggurat/Kconfig.defconfig
```kconfig
if SHIELD_ZIGGURAT_RIGHT

# Name must be less than 16 characters long!
config ZMK_KEYBOARD_NAME
    default "Ziggurat"

config ZMK_SPLIT_ROLE_CENTRAL
    default y

endif

if SHIELD_ZIGGURAT_LEFT || SHIELD_ZIGGURAT_RIGHT

config ZMK_SPLIT
    default y

endif
```

## boards/shields/ziggurat/Kconfig.shield
```kconfig
# No whitespace after the comma or in your part name!
config SHIELD_ZIGGURAT_LEFT
    def_bool $(shields_list_contains,ziggurat_left)

# No whitespace after the comma or in your part name!
config SHIELD_ZIGGURAT_RIGHT
    def_bool $(shields_list_contains,ziggurat_right)
```
